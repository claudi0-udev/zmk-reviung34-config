## boards/shields/r34_handwired/Kconfig.defconfig
```kconfig
if SHIELD_R34_HANDWIRED
config ZMK_KEYBOARD_NAME
    default "R34_HANDWIRED"
endif
```

## boards/shields/reviung34_handwired/Kconfig.defconfig
```kconfig
if SHIELD_REVIUNG34_HANDWIRED
config ZMK_KEYBOARD_NAME
    default "REVIUNG34_HANDWIRED"
endif
```

## boards/shields/reviung34_handwired/Kconfig.shield
```kconfig
config SHIELD_REVIUNG34_HANDWIRED
    def_bool $(shields_list_contains,reviung34_handwired)
```
